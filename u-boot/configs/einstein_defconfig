## u-boot/configs/einstein_defconfig
```kconfig
CONFIG_ARM=y
CONFIG_ARCH_SUNXI=y
CONFIG_SPL=y
CONFIG_SPL_I2C_SUPPORT=y
CONFIG_MACH_SUN7I=y
CONFIG_DRAM_CLK=432

CONFIG_MMC0_CD_PIN="PH1"
CONFIG_MMC_SUNXI_SLOT_EXTRA=2

CONFIG_I2C0_ENABLE=y

CONFIG_CMD_DFU=y
CONFIG_CMD_USB_MASS_STORAGE=y

CONFIG_AXP_GPIO=y
CONFIG_USB0_ID_DET="PH4"
CONFIG_USB0_VBUS_PIN="PB9"
CONFIG_USB0_VBUS_DET="AXP0-VBUS-DETECT"

CONFIG_DEFAULT_DEVICE_TREE="sun7i-a20-einstein"
CONFIG_FASTBOOT_CMD_OEM_FORMAT=y
CONFIG_DFU_RAM=y

CONFIG_ETH_DESIGNWARE=y
CONFIG_RGMII=y
CONFIG_MII=y
CONFIG_SUN7I_GMAC=y
CONFIG_GMAC_TX_DELAY=2
CONFIG_GMAC_RX_DELAY=2

CONFIG_AHCI=y
CONFIG_SCSI=y
CONFIG_SCSI_AHCI=y

CONFIG_USB=y
CONFIG_USB_GADGET=y
CONFIG_USB_MUSB_GADGET=y
CONFIG_USB_EHCI_HCD=y
CONFIG_SYS_USB_EVENT_POLL_VIA_INT_QUEUE=y
```
